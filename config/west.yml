## config/west.yml
```yaml
manifest:
    remotes:
        - name: m165437
          url-base: https://github.com/M165437
    projects:
        - name: nice-view-gem
          remote: m165437
          revision: main
          path: extra-modules/nice-view-gem
    self:
        path: config
```
